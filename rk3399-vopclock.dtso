/dts-v1/;
/plugin/;
#include </usr/src/sys/contrib/device-tree/include/dt-bindings/clock/rk3399-cru.h>
/ {
    compatible = "rockchip,rk3399";
};

&{/clock-controller@ff760000} {
          assigned-clocks =
                        <0x00000008  PLL_GPLL>, <0x00000008 PLL_CPLL>,
                        <0x00000008 PLL_NPLL>,
                        <0x00000008 ACLK_PERIHP>, <0x00000008 HCLK_PERIHP>,
                        <0x00000008 PCLK_PERIHP>,
                        <0x00000008 ACLK_PERILP0>, <0x00000008 HCLK_PERILP0>,
                        <0x00000008 PCLK_PERILP0>, <0x00000008 ACLK_CCI>,
                        <0x00000008 HCLK_PERILP1>, <0x00000008 PCLK_PERILP1>,
                        <0x00000008 ACLK_VIO>, <0x00000008 ACLK_HDCP>,
                        <0x00000008 ACLK_GIC_PRE>,
                        <0x00000008 PCLK_DDR>,
                        <0x00000008 ACLK_VDU>,<0x00000008 ACLK_VOP1>;
                assigned-clock-rates =
                         <594000000>,  <800000000>,
                        <1000000000>,
                         <150000000>,   <75000000>,
                          <37500000>,
                         <100000000>,  <100000000>,
                          <50000000>, <600000000>,
                         <100000000>,   <50000000>,
                         <400000000>, <400000000>,
                         <200000000>,
                         <200000000>,
                         <400000000>,<400000000>;


};
